## CMakeLists.txt
```
# SPDX-License-Identifier: Apache-2.0

cmake_minimum_required(VERSION 3.20.0)
find_package(Zephyr REQUIRED HINTS $ENV{ZEPHYR_BASE})
project(delta_dfu)

target_sources(app PRIVATE src/main.c)
```

## Kconfig
```
#enable support application delta updates, added by Noy 2022-10-09
config BOOT_NOY_DEFINE_DELTA
	bool "App delta update support"
	default n
	depends on MCUBOOT
	help
	  Enable support for updates to the application firmware. 
	  If y, images in the secondary slot can be smaller than a entire application image ,
	  it's just a patch file only the parts of the firmware that have changed instead of the whole firmware.


source "Kconfig.zephyr"
```

## sysbuild.conf
```
#
# Copyright (c) 2024 Nordic Semiconductor
#
# SPDX-License-Identifier: LicenseRef-Nordic-5-Clause
#

SB_CONFIG_MATTER=y
SB_CONFIG_BOOT_SIGNATURE_TYPE_ECDSA_P256=y
SB_CONFIG_PM_OVERRIDE_EXTERNAL_DRIVER_CHECK=n
SB_CONFIG_PM_EXTERNAL_FLASH_MCUBOOT_SECONDARY=n
```

## prj.conf
```kconfig
CONFIG_GPIO=y
CONFIG_DK_LIBRARY=y
CONFIG_PWM=y

# Flash
CONFIG_SOC_FLASH_NRF=y
CONFIG_FLASH=y
CONFIG_FLASH_PAGE_LAYOUT=y
CONFIG_MPU_ALLOW_FLASH_WRITE=y
CONFIG_FLASH_MAP=y
CONFIG_FCB=y
CONFIG_SOC_FLASH_NRF_EMULATE_ONE_BYTE_WRITE_ACCESS=y



#BLE
# CONFIG_BT=y
# CONFIG_BT_PERIPHERAL=y
# CONFIG_BT_CENTRAL=y

#ADC
CONFIG_ADC=y
CONFIG_ADC_ASYNC=y

# #IIC
CONFIG_I2C=y

# SPI
CONFIG_SPI=y

# mcuboot
CONFIG_BOOTLOADER_MCUBOOT=y
CONFIG_STREAM_FLASH=y
CONFIG_IMG_MANAGER=y
CONFIG_MCUBOOT_IMG_MANAGER=y


# cJSON - Used in cloud data encoding.
CONFIG_CJSON_LIB=y



# General config
CONFIG_NEWLIB_LIBC=y
CONFIG_NEWLIB_LIBC_FLOAT_PRINTF=y
CONFIG_ASSERT=y
CONFIG_REBOOT=y
CONFIG_FPU=y


# heap
CONFIG_HEAP_MEM_POOL_SIZE=4096
CONFIG_MAIN_STACK_SIZE=15360
```

## src/main.c
```c
/*
 * Copyright (c) 2016 Open-RnD Sp. z o.o.
 * Copyright (c) 2020 Nordic Semiconductor ASA
 *
 * SPDX-License-Identifier: Apache-2.0
 */

#include <zephyr/kernel.h>
#include <zephyr/device.h>
#include <zephyr/drivers/gpio.h>
#include <zephyr/sys/util.h>
#include <zephyr/sys/printk.h>
#include <inttypes.h>
#include <zephyr/dfu/mcuboot.h>


#define SLEEP_TIME_MS	1000

#define FW_VERSION		"1.4.0"


/*
 * Get button configuration from the devicetree sw0 alias. This is mandatory.
 */
#define SW0_NODE	DT_ALIAS(sw0)
#if !DT_NODE_HAS_STATUS(SW0_NODE, okay)
#error "Unsupported board: sw0 devicetree alias is not defined"
#endif

/* SoC embedded NVM */
#define FLASH_NODEID 	DT_CHOSEN(zephyr_flash_controller)


static const struct gpio_dt_spec button = GPIO_DT_SPEC_GET_OR(SW0_NODE, gpios,{0});
static struct gpio_callback button_cb_data;

volatile bool btnFlag = false;

/*
 * The led0 devicetree alias is optional. If present, we'll use it
 * to turn on the LED whenever the button is pressed.
 */
static struct gpio_dt_spec led = GPIO_DT_SPEC_GET_OR(DT_ALIAS(led0), gpios,{0});

void button_pressed(const struct device *dev, struct gpio_callback *cb, uint32_t pins)
{
	btnFlag = true;
	printk("Version:%s	Button pressed at %" PRIu32 "\n", FW_VERSION,k_uptime_get_32());
	gpio_pin_toggle_dt(&led);
}

int main(void)
{
	int ret = 0;

	//printk("Congratulations!! Delta DFU test successful!!!!!!\r\n");

	if (!device_is_ready(button.port)) {
		printk("Error: button device %s is not ready\n", button.port->name);
		return ret;
	}

	ret = gpio_pin_configure_dt(&button, GPIO_INPUT);
	if (ret != 0) {
		printk("Error %d: failed to configure %s pin %d\n", ret, button.port->name, button.pin);
		return ret;
	}

	ret = gpio_pin_interrupt_configure_dt(&button, GPIO_INT_EDGE_TO_ACTIVE);
	if (ret != 0) {
		printk("Error %d: failed to configure interrupt on %s pin %d\n", ret, button.port->name, button.pin);
		return ret;
	}

	gpio_init_callback(&button_cb_data, button_pressed, BIT(button.pin));
	gpio_add_callback(button.port, &button_cb_data);
	printk("Set up button at %s pin %d\n", button.port->name, button.pin);

	if (led.port && !device_is_ready(led.port)) {
		printk("Error %d: LED device %s is not ready; ignoring it\n", ret, led.port->name);
		led.port = NULL;
	}
	if (led.port) {
		ret = gpio_pin_configure_dt(&led, GPIO_OUTPUT);
		if (ret != 0) {
			printk("Error %d: failed to configure LED device %s pin %d\n", ret, led.port->name, led.pin);
			led.port = NULL;
		} else {
			printk("Set up LED at %s pin %d\n", led.port->name, led.pin);
		}
	}


	printk("Press the button\n");
	while (1) 
	{
		// printk("btnPressFlag = %d\r\n",btnFlag);
		if (btnFlag) 
		{
			printk("start delta upgrade to version %s!!! device will enter mcuboot, please wait...... \r\n", FW_VERSION);
			ret = boot_request_upgrade(BOOT_UPGRADE_PERMANENT);
			if(ret)
			{
				printk("[err=%d]---flash image_ok flag failed!!!\r\n",ret);
			}
	
			btnFlag = false;
		}
		// k_msleep(SLEEP_TIME_MS);
	}

	return ret;
}
```
